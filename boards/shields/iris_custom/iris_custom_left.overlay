/*
 * Copyright (c) 2020 Pete Johanson, Kurtis Lew
 *
 * SPDX-License-Identifier: MIT
 */

#include "iris_custom.dtsi"

&kscan0 {
    col-gpios
        = <&pro_micro  7 GPIO_ACTIVE_HIGH> // E6 (Col 0 - Leftmost)
        , <&pro_micro  8 GPIO_ACTIVE_HIGH> // B4 (Col 1)
        , <&pro_micro  9 GPIO_ACTIVE_HIGH> // B5 (Col 2)
        , <&pro_micro 10 GPIO_ACTIVE_HIGH> // B3 (Col 3)
        , <&pro_micro 16 GPIO_ACTIVE_HIGH> // B2 (Col 4)
        , <&pro_micro 14 GPIO_ACTIVE_HIGH> // B6 (Col 5 - Inner)
        ;
};