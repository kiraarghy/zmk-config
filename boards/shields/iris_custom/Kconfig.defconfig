## boards/shields/iris_custom/Kconfig.defconfig
```kconfig
# Copyright (c) 2026 Your Name
# SPDX-License-Identifier: MIT

if SHIELD_IRIS_CUSTOM_LEFT || SHIELD_IRIS_CUSTOM_RIGHT

config ZMK_SPLIT
    default y

endif

# Required for nice!nano to use P0.09 and P0.10 as raw GPIO columns instead of NFC
CONFIG_NFCT_PINS_AS_GPIOS=y

if SHIELD_IRIS_CUSTOM_LEFT

config ZMK_KEYBOARD_NAME
    default "Iris Custom"

config ZMK_SPLIT_ROLE_CENTRAL
    default y

endif
```

## boards/shields/iris_custom/Kconfig.shield
```kconfig
# Copyright (c) 2020 Pete Johanson, Kurtis Lew
# SPDX-License-Identifier: MIT

config SHIELD_IRIS_CUSTOM_LEFT
    def_bool $(shields_list_contains,iris_custom_left)

config SHIELD_IRIS_CUSTOM_RIGHT
    def_bool $(shields_list_contains,iris_custom_right)
```
